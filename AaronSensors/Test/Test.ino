#include "Playtune.h"
#include <LedControl.h>

//------------------------------------------------
//   scores are put in program space memory
//------------------------------------------------

// Playtune bytestream for file "bach_bwv798.mid" created by MIDITONES V1.1 on Sun Feb 27 12:45:00 2011
const byte PROGMEM score [] = {
0,2, 0x90,59, 0,2, 0x91,51, 0x92,40, 0,13, 0x81, 0,186, 0x82, 0x91,51, 0,4, 0x92,42, 
0,19, 0x81, 0,70, 0x82, 0,12, 0x91,42, 0,9, 0x92,51, 0,13, 0x82, 0,23, 0x81, 0,47, 
0x91,51, 0,2, 0x92,42, 0,31, 0x81, 0,140, 0x82, 0,34, 0x91,42, 0,20, 0x92,51, 0,13, 
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0x80, 0,88, 0x81, 0xf0};
// This score contains 1133 bytes, and 3 tone generators are used.

LedControl lc=LedControl(A0,A2,A1,1);  // Pins: DIN,CLK,CS, # of Display connected
// Put values in arrays
byte invader1a[] =
{
   B00011000,  // First frame of invader #1
   B00111100,
   B01111110,
   B11011011,
   B11111111,
   B00100100,
   B01011010,
   B10100101
};

byte invader1b[] =
{
  B00011000, // Second frame of invader #1
  B00111100,
  B01111110,
  B11011011,
  B11111111,
  B00100100,
  B01011010,
  B01000010
};

#define BUTTON_PIN 2

Playtune pt;

static bool playSong = false;
void myInterrupt()
{
	playSong = true;
}

void setup() {

	Serial.begin(115200);

  lc.shutdown(0,false);  // Wake up displays
  lc.setIntensity(0,5);  // Set intensity levels
  lc.clearDisplay(0);  // Clear Displays

  // Enable all 3 NANO timers for notes that are output on digital pins 10, 11, and 12.
  // Those pins should be wired to 500-ohm resistors, the other ends of which should be connected together
  // to one terminal of an 8-ohm speaker. The other terminal of the speaker should be connected to ground.
  // No other hardware is needed!

  pt.tune_initchan (4); 
  pt.tune_initchan (5);
  pt.tune_initchan (6);

  #define DBUG 0
  #if DBUG
  Serial.begin(9600);
  Serial.println("Debug");
  #endif
  
	// Setup the buttons
	pinMode(BUTTON_PIN, INPUT);
	digitalWrite(BUTTON_PIN, HIGH);
	attachInterrupt(digitalPinToInterrupt(BUTTON_PIN), myInterrupt, HIGH);
}

//  Take values in Arrays and Display them
void sinvader1a()
{
  for (int i = 0; i < 8; i++)  
  {
    lc.setRow(0,i,invader1a[i]);
  }
}

void sinvader1b()
{
  for (int i = 0; i < 8; i++)
  {
    lc.setRow(0,i,invader1b[i]);
  }
}

static bool loopBool = false;
void loop() {
	if(playSong)
	{
		loopBool = !loopBool;
		Serial.println("Loop...!");
		if(loopBool)
			sinvader1a();
		else
			sinvader1b();
		Serial.println("Play Music...!");
		pt.tune_playscore (score); /* start playing */
		while (pt.tune_playing) ; /* wait here until playing stops */
		Serial.println("Wait...!");
		pt.tune_delay(1000); /* wait a second */
		playSong = false;
	}
}